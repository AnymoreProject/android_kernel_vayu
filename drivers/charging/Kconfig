## drivers/charging/Kconfig
```kconfig
config CHARGING_CONTROL
	bool "Infinity Charging Control"
	default y
	help
	  Enable Infinity Kernel charging control driver for Poco X3 Pro.
	  Allows controlling charging via sysfs.
```

## drivers/kernelsu/Kconfig
```kconfig
menu "KernelSU"
config KSU
        bool "KernelSU-Next"
        default n
endmenu
```
